## CMakeLists.txt
```
cmake_minimum_required(VERSION 3.20.0)

list(APPEND ZEPHYR_EXTRA_MODULES ${CMAKE_CURRENT_SOURCE_DIR}/../..)

if(NOT BOARD)
  set(BOARD qemu_riscv32)
endif()

find_package(Zephyr REQUIRED HINTS $ENV{ZEPHYR_BASE})
project(zig_zigzag_tui LANGUAGES C)

zig_sample_app(
  BUILD_FILE ${CMAKE_CURRENT_SOURCE_DIR}/build.zig
  ZIG_SOURCE src/showcase.zig
)

target_sources(app PRIVATE ${CMAKE_CURRENT_SOURCE_DIR}/src/uart_input.c)
```

## prj.conf
```kconfig
CONFIG_ZIG=y
CONFIG_MAIN_STACK_SIZE=65536
```

## src/uart_input.c
```c
#include <stdint.h>

#include <zephyr/device.h>
#include <zephyr/drivers/uart.h>

static const struct device *const console_dev = DEVICE_DT_GET(DT_CHOSEN(zephyr_console));

int zig_uart_poll_in(uint8_t *c) {
	unsigned char ch;
	int ret = uart_poll_in(console_dev, &ch);
	if (ret == 0) {
		*c = ch;
	}
	return ret;
}
```
