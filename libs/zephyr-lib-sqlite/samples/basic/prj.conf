## CMakeLists.txt
```
cmake_minimum_required(VERSION 3.20.0)

get_filename_component(SQLITE_MODULE_DIR ${CMAKE_CURRENT_SOURCE_DIR}/../.. ABSOLUTE)
list(APPEND ZEPHYR_EXTRA_MODULES ${SQLITE_MODULE_DIR})

if(NOT BOARD)
  set(BOARD qemu_riscv32)
endif()

find_package(Zephyr REQUIRED HINTS $ENV{ZEPHYR_BASE})
project(sqlite_basic LANGUAGES C)

target_sources(app PRIVATE
  src/main.c
  src/sqlite_shell.c
)
```

## prj.conf
```kconfig
CONFIG_SQLITE=y

CONFIG_FILE_SYSTEM=y

CONFIG_SHELL=y
CONFIG_FILE_SYSTEM_SHELL=y

CONFIG_COMMON_LIBC_MALLOC_ARENA_SIZE=131072
CONFIG_MAIN_STACK_SIZE=8192
```

## boards/qemu_riscv32.conf
```kconfig
CONFIG_FLASH=y
CONFIG_FLASH_MAP=y
CONFIG_FLASH_SIMULATOR=y
CONFIG_FLASH_PAGE_LAYOUT=y

CONFIG_FILE_SYSTEM_LITTLEFS=y

CONFIG_TEST_RANDOM_GENERATOR=y
```

## src/main.c
```c
#include <zephyr/kernel.h>

#include <sqlite3.h>

#define DB_PATH "/lfs/sample.db"

static int print_row(void *unused, int column_count, char **values, char **names)
{
	ARG_UNUSED(unused);
	for (int i = 0; i < column_count; i++) {
		printk("%s=%s%s", names[i], values[i] ? values[i] : "NULL",
		       i + 1 < column_count ? "  " : "\n");
	}
	return 0;
}

static int exec_sql(sqlite3 *db, const char *sql)
{
	char *err = NULL;
	int rc = sqlite3_exec(db, sql, NULL, NULL, &err);
	if (rc != SQLITE_OK) {
		printk("SQL error (%d): %s\n", rc, err ? err : sqlite3_errmsg(db));
		sqlite3_free(err);
	}
	return rc;
}

int main(void)
{
	printk("SQLite %s on %s\n", sqlite3_libversion(), CONFIG_BOARD);

	sqlite3 *db = NULL;
	int rc = sqlite3_open(DB_PATH, &db);
	if (rc != SQLITE_OK) {
		printk("open %s failed: %s\n", DB_PATH, sqlite3_errmsg(db));
		sqlite3_close(db);
		return 0;
	}

	exec_sql(db, "CREATE TABLE IF NOT EXISTS readings("
		"id INTEGER PRIMARY KEY, sensor TEXT, value REAL);");
	exec_sql(db, "DELETE FROM readings;");
	exec_sql(db, "INSERT INTO readings(sensor, value) VALUES"
		"('temp', 21.5), ('humidity', 48.0), ('pressure', 1013.2);");

	printk("--- readings ---\n");
	sqlite3_exec(db, "SELECT id, sensor, value FROM readings ORDER BY id;",
		     print_row, NULL, NULL);

	sqlite3_close(db);
	printk("done\n");
	return 0;
}
```

## src/sqlite_shell.c
```c
#include <errno.h>
#include <stdio.h>

#include <zephyr/kernel.h>
#include <zephyr/shell/shell.h>

#include <sqlite3.h>

static sqlite3 *current_db;

static int print_row(void *context, int column_count, char **values, char **names)
{
	const struct shell *sh = context;
	for (int i = 0; i < column_count; i++) {
		shell_fprintf(sh, SHELL_NORMAL, "%s=%s%s", names[i],
			      values[i] ? values[i] : "NULL",
			      i + 1 < column_count ? "  " : "\n");
	}
	return 0;
}

static int cmd_open(const struct shell *sh, size_t argc, char **argv)
{
	ARG_UNUSED(argc);
	if (current_db) {
		shell_warn(sh, "database already open; close it first");
		return -EALREADY;
	}
	int rc = sqlite3_open(argv[1], &current_db);
	if (rc != SQLITE_OK) {
		shell_error(sh, "open failed: %s", sqlite3_errmsg(current_db));
		sqlite3_close(current_db);
		current_db = NULL;
		return -EIO;
	}
	shell_print(sh, "opened %s", argv[1]);
	return 0;
}

static int cmd_close(const struct shell *sh, size_t argc, char **argv)
{
	ARG_UNUSED(argc);
	ARG_UNUSED(argv);
	if (!current_db) {
		shell_warn(sh, "no database open");
		return -ENODEV;
	}
	sqlite3_close(current_db);
	current_db = NULL;
	shell_print(sh, "closed");
	return 0;
}

static int cmd_exec(const struct shell *sh, size_t argc, char **argv)
{
	if (!current_db) {
		shell_error(sh, "no database open; run 'sqlite open <path>' first");
		return -ENODEV;
	}

	char sql[CONFIG_SHELL_CMD_BUFF_SIZE];
	size_t offset = 0;
	for (size_t i = 1; i < argc; i++) {
		int needed = snprintf(sql + offset, sizeof(sql) - offset, "%s%s",
				      i > 1 ? " " : "", argv[i]);
		if (needed < 0 || (size_t)needed >= sizeof(sql) - offset) {
			shell_error(sh, "SQL exceeds buffer (%zu bytes)", sizeof(sql));
			return -EMSGSIZE;
		}
		offset += needed;
	}

	char *err = NULL;
	int rc = sqlite3_exec(current_db, sql, print_row, (void *)sh, &err);
	if (rc != SQLITE_OK) {
		shell_error(sh, "SQL error (%d): %s", rc,
			    err ? err : sqlite3_errmsg(current_db));
		sqlite3_free(err);
		return -EINVAL;
	}
	return 0;
}

static int cmd_version(const struct shell *sh, size_t argc, char **argv)
{
	ARG_UNUSED(argc);
	ARG_UNUSED(argv);
	shell_print(sh, "SQLite %s", sqlite3_libversion());
	return 0;
}

SHELL_STATIC_SUBCMD_SET_CREATE(sub_sqlite,
	SHELL_CMD_ARG(open,    NULL, "Open a database file: open <path>",  cmd_open,    2, 0),
	SHELL_CMD_ARG(close,   NULL, "Close the current database",         cmd_close,   1, 0),
	SHELL_CMD_ARG(exec,    NULL, "Execute SQL: exec <sql tokens...>",  cmd_exec,    2, 62),
	SHELL_CMD_ARG(version, NULL, "Print SQLite library version",       cmd_version, 1, 0),
	SHELL_SUBCMD_SET_END
);

SHELL_CMD_REGISTER(sqlite, &sub_sqlite, "SQLite database operations", NULL);
```
