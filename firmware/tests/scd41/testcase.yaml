## firmware/tests/scd41/testcase.yaml
```yaml
tests:
  firmware.renode.scd41:
    integration_platforms:
      - esp32s3_devkitc/esp32s3/procpu
    platform_allow:
      - esp32s3_devkitc/esp32s3/procpu
    tags:
      - firmware
      - renode
      - sensor
      - scd41
    timeout: 30
```

## firmware/tests/unit/Kconfig
```kconfig
source "$(ZEPHYR_BASE)/Kconfig"
source "$(APPLICATION_SOURCE_DIR)/../../src/Kconfig"
```

## firmware/tests/unit/testcase.yaml
```yaml
tests:
  firmware.unit:
    platform_allow:
      - esp32s3_devkitc/esp32s3/procpu
    tags: led
```

## libs/firmware/Kconfig
```kconfig
rsource "networking/wireguard/Kconfig"

config FORCE_HAS_SEGGER_RTT
	bool
	default y
	select HAS_SEGGER_RTT

config FORCE_RUST_SUPPORTED
	bool
	default y
	select RUST_SUPPORTED

config PROMPT_TZ_OFFSET_MINUTES
	int "Prompt clock timezone offset (minutes from UTC)"
	default -240

config FORCE_FILE_SYSTEM_SHELL
	bool
	default y
	depends on SHELL && FILE_SYSTEM
	select FILE_SYSTEM_SHELL

config ESP_SPIRAM
	default y if SOC_SERIES_ESP32S3

config ESP_SPIRAM_MEMTEST
	default y if SOC_SERIES_ESP32S3 && ESP_SPIRAM

config ESP_SPIRAM_HEAP_SIZE
	default 6291456 if BOARD_XIAO_ESP32S3

config ESP32_WIFI_IRAM_OPT
	default y if SOC_SERIES_ESP32S3 && WIFI_ESP32

config ESP32_WIFI_RX_IRAM_OPT
	default y if SOC_SERIES_ESP32S3 && WIFI_ESP32

config ESP32_WIFI_STA_RECONNECT
	default y if SOC_SERIES_ESP32S3 && WIFI_ESP32

choice SPIRAM_MODE
	default SPIRAM_MODE_OCT if BOARD_XIAO_ESP32S3
endchoice

choice ESPTOOLPY_FLASHMODE
	default ESPTOOLPY_FLASHMODE_QIO if BOARD_XIAO_ESP32S3
endchoice

choice ESPTOOLPY_FLASHFREQ
	default ESPTOOLPY_FLASHFREQ_40M if BOARD_XIAO_ESP32S3
endchoice

choice ESPTOOLPY_FLASHSIZE
	default ESPTOOLPY_FLASHSIZE_8MB if BOARD_XIAO_ESP32S3
endchoice

choice WIFI_USAGE_MODE
	default WIFI_USAGE_MODE_STA_AP if BOARD_XIAO_ESP32S3
endchoice
```

## libs/firmware/boards/walter.conf
```kconfig
CONFIG_REGULATOR=y
CONFIG_REGULATOR_FIXED=y

CONFIG_SPIRAM_SPEED_80M=y
CONFIG_ESPTOOLPY_FLASHSIZE_16MB=y
```

## libs/firmware/west.yml
```yaml
manifest:
    remotes:
        - name: zephyrproject
          url-base: https://github.com/zephyrproject-rtos

    projects:
        - name: zephyr
          import: true
          remote: zephyrproject
          revision: e79a0db70fc9ad33982f9786b428b115a78eaadd # 2026-06-14

        - name: zephyr-lang-rust
          remote: zephyrproject
          path: modules/lang/rust
          revision: ab3e546232bfa2f4e16d6c5156b9d9500885b4e8 # 2026-06-12

        - name: mm-iot-zephyr
          import: false
          revision: main
          submodules: true
          path: modules/lib/morsemicro
          url: https://github.com/craigpeacock/mm-iot-zephyr
```

## libs/firmware/zephyr/Kconfig
```kconfig
rsource "../networking/wireguard/Kconfig"

# Upstream ESP32-S3 SoC Kconfig doesn't `select HAS_SEGGER_RTT` even when the
# segger module is present. Force it here so `CONFIG_USE_SEGGER_RTT=y` resolves.
config FORCE_HAS_SEGGER_RTT
	bool
	default y
	select HAS_SEGGER_RTT

config FORCE_RUST_SUPPORTED
	bool
	default y
	select RUST_SUPPORTED

config PROMPT_TZ_OFFSET_MINUTES
	int "Prompt clock timezone offset (minutes from UTC)"
	default 0
```

## libs/zephyr-lang-zig/Kconfig
```kconfig
# Zig configuration options
#
# Copyright (c) 2026 Mumtahin Farabi
# SPDX-License-Identifier: Apache-2.0

menu "Zig Language Support"

config ZIG_SUPPORTED
	bool
	default y if RISCV && !RISCV_ISA_RV32E && !RISCV_ISA_RV128I
	help
	  Selected for platforms that have support for Zig.

config ZIG
	bool "Zig support for the application"
	depends on ZIG_SUPPORTED
	select EXPERIMENTAL
	help
	  This option enables the use of applications written in Zig.

if ZIG

config ZIG_OPTIMIZE
	string "Zig optimization mode"
	default "ReleaseSmall"
	help
	  One of: Debug, ReleaseSafe, ReleaseFast, ReleaseSmall.

config MAIN_STACK_SIZE
	default 8192 if ZTEST

config ZTEST_STACK_SIZE
	default 8192

endif # ZIG

endmenu
```

## libs/zephyr-lib-oh-my-zephyr/Kconfig
```kconfig
config OH_MY_ZEPHYR
	bool "Like oh-my-zsh, but for Zephyr RTOS"
	depends on SHELL
	select SHELL_PROMPT_CHANGE
	select SHELL_VT100_COLORS
	select SHELL_CMDS_RESIZE
	help
	  Shell prompt helpers and powerline-style
	  default prompt for Zephyr RTOS shells.

	  Selects the Zephyr shell features the library calls into:
	    - SHELL_PROMPT_CHANGE (required: set_prompt uses shell_prompt_change)
	    - SHELL_VT100_COLORS (the powerline prompt embeds ANSI escapes)
	    - SHELL_CMDS_RESIZE (probe_terminal_size executes `resize`)

config SHELL_PROMPT_BUFF_SIZE
	default 2048 if OH_MY_ZEPHYR
```

## libs/zephyr-lib-sqlite/Kconfig
```kconfig
config SQLITE
	bool "SQLite3 embedded database engine"
	depends on FILE_SYSTEM
	help
	  SQLite3 amalgamation with a custom VFS over Zephyr's native fs_*
	  API. Single-threaded (SQLITE_THREADSAFE=0); locking is a no-op.

config SQLITE_SHELL
	bool "SQLite shell commands"
	depends on SQLITE
	depends on SHELL
	default y
	help
	  Register a `sqlite` command tree (open/close/exec/version) in
	  the Zephyr shell. Handlers are implemented in Rust; the C side
	  is a thin SHELL_CMD_REGISTER trampoline.
```

## libs/zephyr-ztest-fancy/Kconfig
```kconfig
config ZTEST_FANCY
	bool "Fancy ZTEST runner with BDD narration"
	select ZTEST
	select ZTEST_TC_UTIL_USER_OVERRIDE
	help
	  Enables a ZTEST setup with colored verdict tags ([PASSED]/[FAILED]/
	  [SKIPPED]), START line, the canonical PASS/FAIL/SKIP sentinel that
	  twister's ztest harness parses, and C BDD narration macros
	  (GIVEN/WHEN/THEN/AND from <bdd.h>). Ships a default test_main that
	  runs all ZTEST_SUITEs, verifies coverage, emits TC_END_REPORT, and
	  powers off QEMU via the SiFive test finisher.

if ZTEST_FANCY

config ZTEST_STACK_SIZE
	default 16384

config TEST_LOGGING_DEFAULTS
	default n

config LOG_BACKEND_SHOW_COLOR
	default y

config SHELL_BACKEND_DUMMY
	default y

endif # ZTEST_FANCY
```

## libs/zephyr-ztest-fancy/west.yml
```yaml
manifest:
    remotes:
        - name: zephyrproject
          url-base: https://github.com/zephyrproject-rtos

    projects:
        - name: zephyr
          import: true
          remote: zephyrproject
          revision: e79a0db70fc9ad33982f9786b428b115a78eaadd # 2026-06-14
```

## src/networking/wifi/Kconfig
```kconfig
config WIFI_CREDENTIALS_AP_SSID
	string "Soft AP SSID"
	default "Edge of the Subnet"

config WIFI_CREDENTIALS_AP_PASSWORD
	string "Soft AP WPA2 pre-shared key (empty = open AP)"
	default ""
```
