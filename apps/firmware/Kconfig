## apps/firmware/west.yml
```yaml
manifest:
    remotes:
        - name: zephyrproject
          url-base: https://github.com/zephyrproject-rtos

    projects:
        - name: zephyr-lang-rust
          remote: zephyrproject
          path: zephyrproject/modules/lang/rust
          revision: ab3e546232bfa2f4e16d6c5156b9d9500885b4e8 # 2026-06-12

        - name: zephyr
          remote: zephyrproject
          revision: c0bba90c366 # 2026-08-19
          import:
              path-prefix: zephyrproject
              name-blocklist:
                  - hal_adi
                  - hal_afbr
                  - hal_ambiq
                  - hal_atmel
                  - hal_bouffalolab
                  - hal_ethos_u
                  - hal_gigadevice
                  - hal_infineon
                  - hal_intel
                  - hal_microchip
                  - hal_nuvoton
                  - hal_nxp
                  - hal_openisa
                  - hal_quicklogic
                  - hal_realtek
                  - hal_renesas
                  - hal_rpi_pico
                  - hal_sifli
                  - hal_silabs
                  - hal_tdk
                  - hal_telink
                  - hal_wch
                  - hal_wurthelektronik

                  - bsim
                  - babblesim_base
                  - babblesim_ext_2G4_channel_NtNcable
                  - babblesim_ext_2G4_channel_multiatt
                  - babblesim_ext_2G4_device_WLAN_actmod
                  - babblesim_ext_2G4_device_burst_interferer
                  - babblesim_ext_2G4_device_playback
                  - babblesim_ext_2G4_libPhyComv1
                  - babblesim_ext_2G4_modem_BLE_simple
                  - babblesim_ext_2G4_modem_magic
                  - babblesim_ext_2G4_phy_v1
                  - babblesim_ext_libCryptov1
                  - nrf_hw_models

                  - trusted-firmware-a
                  - trusted-firmware-m
                  - tf-m-tests
                  - psa-arch-tests

                  - edtt
                  - mipi-sys-t
                  - percepio

        - name: dtsh
          revision: zephyr
          path: zephyrproject/modules/tools/dtsh
          west-commands: scripts/west-commands.yml
          url: https://github.com/dottspina/dtsh.git

        - name: zview
          revision: fd128d38e9c9c64690258b33ea4ca72eb724086f # v0.13.1
          path: zephyrproject/modules/tools/zview
          west-commands: scripts/west-commands.yml
          url: https://github.com/wkhadgar/zview.git

        - name: bno08x
          revision: 1c01e81ce7f51b96403203a1a239663d8f39c9ef # 2026-07-01
          path: zephyrproject/modules/lib/bno08x
          url: https://github.com/mvrck-dev/bno08x.git

        - name: zenoh-pico
          revision: 9fb469aa072007e7f9b410e25d06057518892c30 # 2026-07-25
          path: zephyrproject/modules/lib/zenoh-pico
          url: https://github.com/eclipse-zenoh/zenoh-pico

        - name: better_launch
          revision: 26f5be8bea20a6371138314cae47b0877933d0f5 # 2026-10-12
          path: zephyrproject/modules/lib/better_launch
          url: https://github.com/dfki-ric/better_launch

        - name: cadrum
          revision: 77285e51ea2527285101a0dc403b7382971f8717 # 0.9.0 2026-10-13
          path: zephyrproject/modules/lib/cadrum
          url: https://github.com/lzpel/cadrum

        - name: ros2_link6
          revision: 17e78b57f89a9277746a3286c0723890d2e20627 # jazzy 2026-10-12
          path: zephyrproject/modules/ros/ros2_link6
          url: https://github.com/Kinovarobotics/ros2_link6

        - name: cartesian_controllers
          revision: f8aad77697802d9b9ca08d044b87ce58167e4bf9 # ros2 2026-10-12
          path: zephyrproject/modules/ros/cartesian_controllers
          url: https://github.com/fzi-forschungszentrum-informatik/cartesian_controllers

        - name: ros2_robotiq_gripper
          revision: a74d007d8f2f06dc6a503ad21038ba869d4999a6 # main 2026-10-12
          path: zephyrproject/modules/ros/ros2_robotiq_gripper
          url: https://github.com/PickNikRobotics/ros2_robotiq_gripper

        - name: picknik_controllers
          revision: 8b5f4ab308ee82198c55e1722de23ed60142a37d # main 2026-10-12
          path: zephyrproject/modules/ros/picknik_controllers
          url: https://github.com/picknikrobotics/picknik_controllers

        - name: serial
          revision: d8d160678aa0b31cdf467c052b954fa287cc6cdf # ros2 2026-10-12
          path: zephyrproject/modules/ros/serial
          url: https://github.com/tylerjw/serial

        - name: play_motion2
          revision: 5e41e66d7b9adf057b5a6f8bdd3a00d3918993b2 # humble-devel 2026-10-13
          path: zephyrproject/modules/ros/play_motion2
          url: https://github.com/pal-robotics/play_motion2

        - name: mujoco_ros2_control
          revision: 8a083ffb1fb75e33ecd8c602d7fb06845f7cc6b8 # main 2026-10-14
          path: zephyrproject/modules/ros/mujoco_ros2_control
          url: https://github.com/ros-controls/mujoco_ros2_control

        - name: nuttx
          revision: ab4890df16b63af85f546d05d7a7fe3a3ebf3980 # 2026-07-30
          path: zephyrproject/nuttx
          url: https://github.com/apache/nuttx

        - name: nuttx-apps
          revision: 2492317f15bcf69787249060a6b16915170cc3a3 # 2026-07-28
          path: zephyrproject/apps
          url: https://github.com/apache/nuttx-apps

        - name: lichtblick
          revision: c3d6b2f845fbe5259f19e9eb2544b8b966448a6a # v1.28.0-284 (fork base)
          path: zephyrproject/lichtblick
          url: https://github.com/lichtblick-suite/lichtblick
```

## apps/robot/west.yml
```yaml
manifest:
    projects:
        - name: better_launch
          revision: 73f48b4cf8269bad69b15d8559eaaf7f7007deb3 # devel 2026-11-10
          path: vendor/better_launch
          url: https://github.com/dfki-ric/better_launch

        - name: ros2_link6
          revision: f48e2d79bcd94b671e03b85594dcbe1e11aa434c # jazzy 2026-11-02
          path: vendor/ros2_link6
          url: https://github.com/Kinovarobotics/ros2_link6

        - name: cartesian_controllers
          revision: f8aad77697802d9b9ca08d044b87ce58167e4bf9 # ros2 2026-10-12
          path: vendor/cartesian_controllers
          url: https://github.com/fzi-forschungszentrum-informatik/cartesian_controllers

        - name: ros2_robotiq_gripper
          revision: a74d007d8f2f06dc6a503ad21038ba869d4999a6 # main 2026-10-12
          path: vendor/ros2_robotiq_gripper
          url: https://github.com/PickNikRobotics/ros2_robotiq_gripper

        - name: picknik_controllers
          revision: 8b5f4ab308ee82198c55e1722de23ed60142a37d # main 2026-10-12
          path: vendor/picknik_controllers
          url: https://github.com/picknikrobotics/picknik_controllers

        - name: serial
          revision: d8d160678aa0b31cdf467c052b954fa287cc6cdf # ros2 2026-10-12
          path: vendor/serial
          url: https://github.com/tylerjw/serial

        - name: play_motion2
          revision: fbd9bbafe44acd662d3f9018b5ffb848f0f66cdd # 1.8.8
          path: vendor/play_motion2
          url: https://github.com/pal-robotics/play_motion2

        - name: ros2_controllers
          revision: a118def4ee2c9edbd43ef61846598f9ed2d6547a # last gripper_controllers rev, parent of removal #1652 2025-05-17
          path: vendor/ros2_controllers
          url: https://github.com/ros-controls/ros2_controllers

        - name: mujoco_ros2_control
          revision: 6838a7fe45a4fc0e9a36ea013032c9d2f9537be7 # main 2026-11-04
          path: vendor/mujoco_ros2_control
          url: https://github.com/ros-controls/mujoco_ros2_control

        - name: zed-ros2-wrapper
          revision: f134486a814111b1c737a41211113dee41921776 # master 2026-11-02
          path: vendor/zed-ros2-wrapper
          url: https://github.com/stereolabs/zed-ros2-wrapper

        - name: zed-ros2-interfaces
          revision: 8f86e35268881258cd3df98ab67afd2da5478e4d # master 2026-11-07
          path: vendor/zed-ros2-interfaces
          url: https://github.com/stereolabs/zed-ros2-interfaces

        - name: nmea_navsat_driver
          revision: 0ffe0aa764d60395437ab232ba913bdbe0c73f8a # ros2 2026-10-18
          path: vendor/nmea_navsat_driver
          url: https://github.com/ros-drivers/nmea_navsat_driver

        - name: audio_common
          revision: cf6360ff871cfa69f4a7e7c774969d330bf119a8 # main 2026-10-29
          path: vendor/audio_common
          url: https://github.com/mgonzs13/audio_common

        - name: phenobench-baselines
          revision: 78db625441e54c5b64efabeb0d886d020961665b # main 2024-01-23
          path: vendor/phenobench-baselines
          url: https://github.com/PRBonn/phenobench-baselines
```

## libs/zephyr-lib-sh8601/Kconfig
```kconfig
config SH8601
	bool "SH8601 AMOLED display controller"
	default y
	depends on DT_HAS_SINOWEALTH_SH8601_ENABLED
	depends on DISPLAY
	select MIPI_DBI
	help
	  DCS driver for the Sino Wealth SH8601 AMOLED controller over the
	  MIPI-DBI API.

DT_COMPAT_MIPI_DBI_ESP32_QSPI := mipi-dbi-esp32-qspi

config MIPI_DBI_ESP32_QSPI
	bool "ESP32-S3 GPSPI quad-SPI MIPI-DBI transport"
	default y
	depends on DT_HAS_MIPI_DBI_ESP32_QSPI_ENABLED
	depends on MIPI_DBI
	depends on SOC_SERIES_ESP32S3
	select DMA if $(dt_compat_any_has_prop,$(DT_COMPAT_MIPI_DBI_ESP32_QSPI),dmas)
	help
	  MIPI-DBI transport for QSPI DCS panels driven by the ESP32-S3 GPSPI
	  peripheral, with commands on one data line and pixel data on four.
```

## libs/zephyr-lib-sh8601/dts/bindings/mipi-dbi-esp32-qspi.yaml
```yaml
description: ESP32 GPSPI quad-SPI MIPI-DBI transport for DCS panels

compatible: "mipi-dbi-esp32-qspi"

include: base.yaml

bus: mipi-dbi

properties:
  reg:
    required: true

  clocks:
    required: true

  spi-host:
    type: int
    required: true
    description: GPSPI host index (0 for SPI1, 1 for SPI2, 2 for SPI3).

  sclk-pin:
    type: int
    required: true
    description: GPIO number routed to the QSPI clock output.

  sio-pins:
    type: array
    required: true
    description: GPIO numbers routed to QSPI data lines SIO0 through SIO3.

  cs-gpios:
    type: phandle-array
    required: true
    description: Chip select line, driven around each transaction.

  reset-gpios:
    type: phandle-array
    description: |
      Panel domain reset lines, asserted and released together by
      mipi_dbi_reset. List every line the panel module needs pulsed as one
      group (reset, power enable, touch reset).

  clock-frequency:
    type: int
    required: true
    description: QSPI clock frequency in Hz.

  "#address-cells":
    const: 1

  "#size-cells":
    const: 0
```

## libs/zephyr-lib-sh8601/dts/bindings/sinowealth,sh8601.yaml
```yaml
description: SH8601 AMOLED display controller

compatible: "sinowealth,sh8601"

on-bus: mipi-dbi

include: [base.yaml, display-controller.yaml, lcd-controller.yaml]

properties:
  reg:
    required: true
```
