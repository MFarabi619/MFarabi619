## apps/firmware/Kconfig
```kconfig
if SOC_SERIES_ESP32S3

configdefault IMG_MANAGER
	default y
configdefault IMG_ERASE_PROGRESSIVELY
	default y

configdefault MCUBOOT_SHELL
	default y

configdefault STREAM_FLASH
	default y

configdefault ZVFS_OPEN_MAX
	default 24

configdefault NVS_INIT_BAD_MEMORY_REGION
	default y

configdefault MAIN_STACK_SIZE
	default 8192
configdefault ESPTOOLPY_FLASH_MODE_AUTO_DETECT
	default n
configdefault DEBUG_THREAD_INFO
	default y

choice COMPILER_OPTIMIZATIONS
	default DEBUG_OPTIMIZATIONS
endchoice

configdefault SYMTAB
	default y
configdefault INIT_STACKS
	default y
configdefault STACK_SENTINEL
	default y
configdefault DEBUG_COREDUMP
	default y

choice DEBUG_COREDUMP_MEMORY_DUMP
	default DEBUG_COREDUMP_MEMORY_DUMP_MIN
endchoice

choice DEBUG_COREDUMP_BACKEND
	default DEBUG_COREDUMP_BACKEND_LOGGING
endchoice

configdefault RAM_CONSOLE
	default y
configdefault RAM_CONSOLE_BUFFER_SIZE
	default 4096

configdefault GPIO_SHELL
	default y
configdefault STATS
	default y
configdefault STATS_SHELL
	default y
configdefault THREAD_ANALYZER
	default y
configdefault SETTINGS_SHELL
	default y
configdefault SETTINGS_RUNTIME
	default y

configdefault MCUMGR
	default y
configdefault ZCBOR
	default y
configdefault BASE64
	default y
configdefault MCUMGR_GRP_OS
	default y
configdefault MCUMGR_GRP_IMG
	default y
configdefault MCUMGR_GRP_STAT
	default y
configdefault MCUMGR_GRP_ENUM
	default y
configdefault MCUMGR_GRP_ZBASIC
	default y
configdefault MCUMGR_GRP_OS_INFO
	default y
configdefault MCUMGR_GRP_SETTINGS
	default y
configdefault MCUMGR_GRP_OS_TASKSTAT
	default y
configdefault MCUMGR_GRP_ENUM_DETAILS
	default y
configdefault MCUMGR_GRP_IMG_SLOT_INFO
	default y
configdefault MCUMGR_GRP_OS_MCUMGR_PARAMS
	default y
configdefault MCUMGR_GRP_OS_BOOTLOADER_INFO
	default y
configdefault MCUMGR_GRP_ZBASIC_STORAGE_ERASE
	default y
configdefault UART_CONSOLE_MCUMGR
	default y
configdefault MCUMGR_TRANSPORT_UDP
	default y
configdefault MCUMGR_TRANSPORT_UDP_IPV4
	default y
configdefault MCUMGR_TRANSPORT_SHELL
	default y
configdefault MCUMGR_TRANSPORT_UDP_STACK_SIZE
	default 4096
configdefault MCUMGR_TRANSPORT_WORKQUEUE_STACK_SIZE
	default 8192

configdefault NETWORKING
	default y
configdefault NET_LOG
	default y
configdefault NET_SHELL
	default y
configdefault NET_MAX_CONN
	default 16
configdefault NET_CONNECTION_MANAGER
	default y
configdefault NET_TC_TX_COUNT
	default 1
configdefault NET_MGMT_EVENT_QUEUE_SIZE
	default 10
configdefault NET_MGMT_EVENT_STACK_SIZE
	default 4096

choice NET_TC_THREAD_TYPE
	default NET_TC_THREAD_COOPERATIVE
endchoice

configdefault NET_IPV4
	default y
configdefault NET_IPV4_IGMP
	default y
configdefault NET_IPV4_MTU
	default 1500
configdefault NET_IF_MAX_IPV4_COUNT
	default 3
configdefault NET_IPV6
	default n

configdefault NET_SOCKETS
	default y
configdefault NET_SOCKETS_SERVICE_STACK_SIZE
	default 8192
configdefault NET_TCP
	default y
configdefault NET_TCP_MAX_SEND_WINDOW_SIZE
	default 16384
configdefault NET_TCP_MAX_RECV_WINDOW_SIZE
	default 16384
configdefault NET_UDP
	default y
configdefault NET_MAX_CONTEXTS
	default 16
configdefault NET_CONTEXT_RCVTIMEO
	default y
configdefault ZVFS_POLL_MAX
	default 32
configdefault ZVFS_EVENTFD_MAX
	default 2

configdefault NET_BUF_POOL_USAGE
	default y
configdefault NET_BUF_DATA_SIZE
	default 1500
configdefault NET_BUF_RX_COUNT
	default 256
configdefault NET_BUF_TX_COUNT
	default 256

configdefault NET_STATISTICS
	default y
configdefault NET_STATISTICS_USER_API
	default y
configdefault NET_STATISTICS_PER_INTERFACE
	default y

configdefault NET_HOSTNAME_ENABLE
	default y
configdefault NET_HOSTNAME_UNIQUE
	default n

configdefault NET_DHCPV4
	default y
configdefault NET_DHCPV4_SERVER
	default y
configdefault NET_DHCPV4_INITIAL_DELAY_MAX
	default 2
configdefault NET_DHCPV4_SERVER_ICMP_PROBE_TIMEOUT
	default 0
configdefault NET_DHCPV4_SERVER_OPTION_DNS_ADDRESS
	default "192.168.4.1"

configdefault DNS_RESOLVER
	default y
configdefault DNS_RESOLVER_CACHE
	default y
configdefault DNS_RESOLVER_MAX_SERVERS
	default 3
configdefault DNS_RESOLVER_AI_MAX_ENTRIES
	default 8
configdefault DNS_RESOLVER_MAX_NAME_LEN
	default 128
configdefault DNS_RESOLVER_MAX_ANSWER_SIZE
	default 2048
configdefault DNS_RESOLVER_CACHE_MAX_ENTRIES
	default 16
configdefault DNS_NUM_CONCUR_QUERIES
	default 32
configdefault DNS_SERVER1
	default "1.1.1.1"
configdefault DNS_SERVER2
	default "8.8.8.8"
configdefault DNS_SERVER3
	default "9.9.9.9"
configdefault DNS_SERVER_IP_ADDRESSES
	default y
configdefault MDNS_RESOLVER
	default y
configdefault MDNS_RESPONDER
	default y

configdefault SNTP
	default y
configdefault DATE_SHELL
	default y
configdefault NET_CONFIG_SETTINGS
	default y
configdefault NET_CONFIG_AUTO_INIT
	default n
configdefault NET_CONFIG_CLOCK_SNTP_INIT
	default y
configdefault NET_CONFIG_SNTP_INIT_RESYNC
	default y
configdefault NET_CONFIG_SNTP_INIT_SERVER
	default "pool.ntp.org"
configdefault NET_CONFIG_SNTP_INIT_USE_CONNECTION_MANAGER
	default y

configdefault WIFI
	default y
configdefault WIFI_NM
	default y
configdefault NET_L2_WIFI_SHELL
	default y
configdefault WIFI_SHELL_MAX_AP_STA
	default 8
configdefault WIFI_CREDENTIALS
	default y
configdefault WIFI_CREDENTIALS_SHELL
	default y
configdefault WIFI_CREDENTIALS_CONNECT_STORED
	default y

choice WIFI_CREDENTIALS_BACKEND
	default WIFI_CREDENTIALS_BACKEND_SETTINGS
endchoice

choice WIFI_LOG_LEVEL_CHOICE
	default WIFI_LOG_LEVEL_INF
endchoice

choice WIFI_NM_LOG_LEVEL_CHOICE
	default WIFI_NM_LOG_LEVEL_INF
endchoice

configdefault FLASH
	default y
configdefault FLASH_PAGE_LAYOUT
	default y
configdefault FLASH_MAP
	default y
configdefault NVS
	default y
configdefault SETTINGS
	default y

choice SETTINGS_BACKEND
	default SETTINGS_NVS
endchoice

configdefault ESP_SPIRAM
	default y
configdefault ESP32_WIFI_NET_ALLOC_SPIRAM
	default y

choice ESP_WIFI_HEAP
	default ESP_WIFI_HEAP_SPIRAM
endchoice

endif # SOC_SERIES_ESP32S3

source "Kconfig.zephyr"
```

## apps/firmware/Kconfig.sysbuild
```kconfig
choice BOOTLOADER
	default BOOTLOADER_MCUBOOT if SOC_FAMILY_ESPRESSIF_ESP32
endchoice

choice MCUBOOT_MODE
	default MCUBOOT_MODE_SWAP_USING_OFFSET if SOC_FAMILY_ESPRESSIF_ESP32
endchoice

source "share/sysbuild/Kconfig"
```

## apps/firmware/boards/beagley_ai_j722s_mcu_r5f0_0.conf
```kconfig
CONFIG_RAM_CONSOLE=y
CONFIG_OPENAMP_RSC_TABLE=y
CONFIG_MEM_ATTR=y
CONFIG_UART_CONSOLE=n
CONFIG_SHELL_BACKEND_SERIAL=n
CONFIG_OH_MY_ZEPHYR=n
```

## apps/firmware/boards/esp32s3_touch_lcd_1_28_esp32s3_procpu.conf
```kconfig
CONFIG_NET_HOSTNAME="amoled"

CONFIG_OH_MY_ZEPHYR=n
CONFIG_USE_SEGGER_RTT=n

CONFIG_ESPTOOLPY_OCT_FLASH=n
CONFIG_SPIRAM_MODE_OCT=y

CONFIG_HEAP_MEM_POOL_SIZE=32768
CONFIG_STACK_SENTINEL=y

CONFIG_I2C=y
CONFIG_I2C_SHELL=y
CONFIG_GPIO_SHELL=y
CONFIG_INPUT_SHELL=y
CONFIG_GPIO_HOGS_INIT_PRIORITY=60

CONFIG_RTC=y
CONFIG_RTC_SHELL=y

CONFIG_SENSOR=y
CONFIG_SENSOR_SHELL=y

CONFIG_MFD=y
CONFIG_FUEL_GAUGE=y

CONFIG_LOG_MODE_IMMEDIATE=y

CONFIG_SDHC=y
CONFIG_SDMMC_STACK=y

CONFIG_DISK_ACCESS=y
CONFIG_DISK_DRIVER_SDMMC=y

CONFIG_FILE_SYSTEM=y
CONFIG_FILE_SYSTEM_SHELL=y

CONFIG_FAT_FILESYSTEM_ELM=y

CONFIG_FLASH=y
CONFIG_FLASH_MAP=y

CONFIG_ZMS=y
CONFIG_SETTINGS=y
CONFIG_SETTINGS_ZMS=y
CONFIG_SETTINGS_SHELL=y

CONFIG_INPUT=y
CONFIG_DISPLAY=y

CONFIG_LVGL=y
CONFIG_LV_Z_SHELL=y
CONFIG_LV_USE_LINE=y
CONFIG_LV_USE_GRID=y
CONFIG_LV_USE_LABEL=y
CONFIG_LV_Z_VDB_SIZE=3
CONFIG_LV_USE_BUTTON=y
CONFIG_LV_FONT_MONTSERRAT_28=y
CONFIG_LV_Z_MEM_POOL_SIZE=32768
CONFIG_LV_FONT_DEFAULT_MONTSERRAT_28=y
CONFIG_LV_Z_MEMORY_POOL_ZEPHYR_REGION=y
CONFIG_LV_Z_MEMORY_POOL_ZEPHYR_REGION_NAME=".ext_ram.bss"

CONFIG_POSIX_API=y
CONFIG_MAX_PTHREAD_COND_COUNT=16
CONFIG_MAX_PTHREAD_MUTEX_COUNT=32

CONFIG_ZENOH_PICO=y
CONFIG_ZENOH_PICO_LINK_TCP=y
CONFIG_ZENOH_PICO_INTEREST=y
CONFIG_ZENOH_PICO_MATCHING=y
CONFIG_ZENOH_PICO_TCP_NODELAY=y
CONFIG_ZENOH_PICO_PUBLICATION=y
CONFIG_ZENOH_PICO_MULTI_THREAD=y
CONFIG_ZENOH_PICO_SESSION_CHECK=y
CONFIG_ZENOH_PICO_AUTO_RECONNECT=y
CONFIG_ZENOH_PICO_UNICAST_TRANSPORT=y
# CONFIG_ZENOH_LOCATOR_DEFAULT="tcp/10.81.190.189:7447"
# CONFIG_ZENOH_LOCATOR_DEFAULT="tcp/10.66.92.201:7447"
CONFIG_ZENOH_LOCATOR_DEFAULT="tcp/192.168.20.236:7447"
```

## apps/firmware/boards/m5stack_atoms3_lite_esp32s3_procpu.conf
```kconfig
CONFIG_NET_HOSTNAME="atoms3-lite"

CONFIG_ESPTOOLPY_OCT_FLASH=n
CONFIG_ESP_SPIRAM=n

CONFIG_I2C=y
CONFIG_I2C_SHELL=y

CONFIG_LED_STRIP=y
CONFIG_LED_STRIP_SHELL=y

CONFIG_ESP_WIFI_HEAP_SYSTEM=y
CONFIG_HEAP_MEM_POOL_SIZE=65536

CONFIG_ESP32_WIFI_STATIC_RX_BUFFER_NUM=8
CONFIG_ESP32_WIFI_DYNAMIC_RX_BUFFER_NUM=16
CONFIG_ESP32_WIFI_DYNAMIC_TX_BUFFER_NUM=16

CONFIG_NET_MAX_CONN=8
CONFIG_NET_MAX_CONTEXTS=6
CONFIG_NET_BUF_RX_COUNT=8
CONFIG_NET_BUF_TX_COUNT=8
CONFIG_NET_PKT_RX_COUNT=16
CONFIG_NET_PKT_TX_COUNT=16
CONFIG_NET_CONFIG_CLOCK_SNTP_INIT=n
CONFIG_NET_TCP_MAX_SEND_WINDOW_SIZE=4096
CONFIG_NET_TCP_MAX_RECV_WINDOW_SIZE=4096

CONFIG_ZENOH_PICO=y
CONFIG_ZENOH_PICO_LINK_TCP=y
CONFIG_ZENOH_PICO_TCP_NODELAY=y
CONFIG_ZENOH_PICO_SUBSCRIPTION=y
CONFIG_ZENOH_PICO_MULTI_THREAD=y
CONFIG_ZENOH_PICO_SESSION_CHECK=y
CONFIG_ZENOH_PICO_AUTO_RECONNECT=y
CONFIG_ZENOH_PICO_UNICAST_TRANSPORT=y
CONFIG_ZENOH_LOCATOR_DEFAULT="tcp/10.0.0.247:7447"

CONFIG_NET_TCP=y
CONFIG_NET_SOCKETS=y

CONFIG_POSIX_API=y
CONFIG_MAX_PTHREAD_COND_COUNT=16
CONFIG_MAX_PTHREAD_MUTEX_COUNT=32
```

## apps/firmware/boards/mps2_an386.conf
```kconfig
CONFIG_FPU=y

CONFIG_CMSIS_DSP=y
CONFIG_CMSIS_DSP_CONTROLLER=y
CONFIG_CMSIS_DSP_FILTERING=y
```

## apps/firmware/boards/nucleo_h755zi_q_stm32h755xx_m7.conf
```kconfig
CONFIG_GPIO=y

CONFIG_I2C=y
CONFIG_I2C_SHELL=y

CONFIG_SENSOR=y
CONFIG_SENSOR_SHELL=y

CONFIG_CBPRINTF_FP_SUPPORT=y
CONFIG_MAIN_STACK_SIZE=2048

CONFIG_SHELL_LOG_BACKEND=n
```

## apps/firmware/boards/xiao_esp32s3_esp32s3_procpu.conf
```kconfig
CONFIG_NET_HOSTNAME="xiao"

CONFIG_ESPTOOLPY_OCT_FLASH=n

CONFIG_PWM=y
CONFIG_PWM_SHELL=y
CONFIG_GPIO_SHELL=y

CONFIG_LED=y
CONFIG_LED_SHELL=y

CONFIG_HEAP_MEM_POOL_SIZE=32768

# adeept-robot-hat
# CONFIG_I2C=y
# CONFIG_I2C_SHELL=y
# CONFIG_PWM_PCA9685=y

# freenove-fnk007
# CONFIG_SPI=y
# CONFIG_LED_STRIP=y
# CONFIG_WS2812_STRIP=y

CONFIG_ZENOH_PICO=y
CONFIG_ZENOH_PICO_SUBSCRIPTION=y
CONFIG_ZENOH_PICO_MULTI_THREAD=y
CONFIG_ZENOH_PICO_LINK_TCP=y
CONFIG_ZENOH_PICO_UNICAST_TRANSPORT=y
CONFIG_ZENOH_PICO_SESSION_CHECK=y
CONFIG_ZENOH_PICO_AUTO_RECONNECT=y
CONFIG_ZENOH_PICO_TCP_NODELAY=y
CONFIG_ZENOH_LOCATOR_DEFAULT="tcp/10.0.0.247:7447"
CONFIG_NET_TCP=y
CONFIG_NET_SOCKETS=y
CONFIG_POSIX_API=y
CONFIG_MAX_PTHREAD_MUTEX_COUNT=32
CONFIG_MAX_PTHREAD_COND_COUNT=16

CONFIG_NET_CONFIG_CLOCK_SNTP_INIT=n
```

## apps/firmware/boards/xiao_esp32s3_esp32s3_procpu_sense.conf
```kconfig
CONFIG_NET_HOSTNAME="xiao-sense"

CONFIG_ESPTOOLPY_OCT_FLASH=n

# CONFIG_SQLITE=y

CONFIG_SDMMC_STACK=y
CONFIG_FS_FATFS_EXFAT=y

CONFIG_MCUMGR_GRP_FS=y
CONFIG_MCUMGR_GRP_FS_FILE_STATUS=y
CONFIG_MCUMGR_GRP_FS_HASH_SHA256=y
CONFIG_MCUMGR_GRP_FS_CHECKSUM_HASH=y
CONFIG_MCUMGR_GRP_FS_MAX_FILE_SIZE_4GB=y
CONFIG_MCUMGR_GRP_FS_CHECKSUM_IEEE_CRC32=y

CONFIG_FILE_SYSTEM=y
CONFIG_FILE_SYSTEM_MKFS=y
CONFIG_FILE_SYSTEM_SHELL_TEST_COMMANDS=y
CONFIG_FS_LOG_LEVEL_DBG=y
CONFIG_FS_FATFS_LFN=y
CONFIG_FS_FATFS_HAS_RTC=y
CONFIG_FS_FATFS_EXTRA_NATIVE_API=y
CONFIG_FAT_FILESYSTEM_ELM=y

CONFIG_HTTP_PARSER=y
CONFIG_HTTP_PARSER_URL=y
CONFIG_HTTP_SERVER=y
CONFIG_HTTP_SERVER_COMPRESSION=y
CONFIG_HTTP_SERVER_RESOURCE_WILDCARD=y
CONFIG_HTTP_SERVER_STACK_SIZE=8192
CONFIG_HTTP_SERVER_CLIENT_BUFFER_SIZE=1024
CONFIG_HTTP_SERVER_MAX_URL_LENGTH=512
CONFIG_EVENTFD=y

CONFIG_PWM=y
CONFIG_PWM_SHELL=y
CONFIG_GPIO_SHELL=y

CONFIG_SPI=y
CONFIG_LED=y
CONFIG_LED_SHELL=y
CONFIG_LED_STRIP=y
CONFIG_LED_STRIP_SHELL=y

# freenove-fnk0077:
CONFIG_WS2812_STRIP_SPI=y

CONFIG_HEAP_MEM_POOL_SIZE=32768

# zenoh-pico:
CONFIG_ZENOH_PICO=y
CONFIG_ZENOH_PICO_SUBSCRIPTION=y
CONFIG_ZENOH_PICO_MULTI_THREAD=y
CONFIG_ZENOH_PICO_LINK_TCP=y
CONFIG_ZENOH_PICO_UNICAST_TRANSPORT=y
CONFIG_ZENOH_PICO_SESSION_CHECK=y
CONFIG_ZENOH_PICO_AUTO_RECONNECT=y
CONFIG_ZENOH_PICO_TCP_NODELAY=y
CONFIG_NET_TCP=y
CONFIG_NET_SOCKETS=y
CONFIG_POSIX_API=y
CONFIG_MAX_PTHREAD_MUTEX_COUNT=32
CONFIG_MAX_PTHREAD_COND_COUNT=16
```

## apps/firmware/dts/bindings/cytron,md30c.yaml
```yaml
# SPDX-License-Identifier: Apache-2.0

include: base.yaml
compatible: "cytron,md30c"
description: Cytron MD30C dual DC-motor driver hat.
properties:
  pwms:
    type: phandle-array
    required: true
    description: PWM magnitude channel per wheel (left, right).
  pwm-names:
    type: string-array
    required: true
  dir-gpios:
    type: phandle-array
    required: true
    description: Direction GPIO per wheel (left, right).
```

## apps/firmware/dts/bindings/espressif,esp-hosted-sdio.yaml
```yaml
description: |
  ESP-Hosted Wi-Fi co-processor reached over SDIO. For boards where an
  ESP32-C6 (or similar) radio is wired to the host SoC's SDIO bus and runs
  esp-hosted-mcu slave firmware.

compatible: "espressif,esp-hosted-sdio"

include: base.yaml

properties:
  sdhc:
    type: phandle
    required: true
    description: SDHC slot the co-processor's SDIO interface is connected to.

  reset-gpios:
    type: phandle-array
    required: true
    description: |
      Co-processor enable/reset line. Active-high on this board: driven high
      enables the co-processor, low holds it in reset.
```

## apps/firmware/dts/bindings/freenove,fnk0077.yaml
```yaml
# SPDX-License-Identifier: Apache-2.0

include: base.yaml
compatible: "freenove,fnk0077"
description: Freenove FNK0077 dual DC-motor driver hat.
properties:
  pwms:
    type: phandle-array
    required: true
    description: Forward and backward PWM channel per wheel.
  pwm-names:
    type: string-array
    required: true
```

## apps/firmware/dts/bindings/m5stack,unit-8servos.yaml
```yaml
# SPDX-License-Identifier: Apache-2.0

include: [i2c-device.yaml]
compatible: "m5stack,unit-8servos"
description: I2C 8-channel servo/GPIO/ADC/PWM/NeoPixel expander.
```

## apps/firmware/dts/bindings/pwm-motors.yaml
```yaml
# SPDX-License-Identifier: Apache-2.0

include: base.yaml
compatible: "pwm-motors"
description: Sign-magnitude DC-motor driver — one PWM (magnitude) + one DIR GPIO per wheel.
properties:
  pwms:
    type: phandle-array
    required: true
    description: PWM magnitude channel per wheel (left, right).
  pwm-names:
    type: string-array
    required: true
  dir-gpios:
    type: phandle-array
    required: true
    description: Direction GPIO per wheel (left, right).
```

## apps/firmware/nuttx/Kconfig
```kconfig
config APPS_NUTTX_ZIG
	tristate "Zig teleop pendant (zigzag TUI)"
	default n
	---help---
		Zig teleop pendant built on the zigzag TUI framework, rendered
		over the serial console. Arrow keys / WASD set linear and angular
		commands; space stops; q quits.

if APPS_NUTTX_ZIG

config APPS_NUTTX_ZIG_PROGNAME
	string "Program name"
	default "nuttx_zig"

config APPS_NUTTX_ZIG_PRIORITY
	int "Task priority"
	default 100

config APPS_NUTTX_ZIG_STACKSIZE
	int "Stack size"
	default 32768

endif
```
