## apps/firmware/drivers/input/pwm_rc_receiver/Kconfig
```kconfig
config INPUT_PWM_RC_RECEIVER
	bool "PWM RC receiver input driver"
	default y
	depends on DT_HAS_PWM_RC_RECEIVER_ENABLED
	select PWM
	select PWM_CAPTURE
	help
	  RC receiver with one PWM output per channel, read with PWM capture.

if INPUT_PWM_RC_RECEIVER

config INPUT_PWM_RC_RECEIVER_THREAD_STACK_SIZE
	int "Stack size for the PWM RC receiver thread"
	default 1024

config INPUT_PWM_RC_RECEIVER_THREAD_PRIORITY
	int "Priority for the PWM RC receiver thread"
	default 0

endif # INPUT_PWM_RC_RECEIVER
```

## apps/firmware/dts/bindings/input/pwm-rc-receiver.yaml
```yaml
# SPDX-License-Identifier: Apache-2.0

include: base.yaml
compatible: "pwm-rc-receiver"
description: |
  RC receiver with one PWM output per channel, read with PWM capture.

  Each channel reports its pulse width in microseconds, followed by a sync event.
  Reporting stops when the receiver loses signal.

properties:
  poll-period-ms:
    type: int
    default: 20
    description: Reporting period in milliseconds.

  signal-timeout-ms:
    type: int
    default: 100
    description: Time without a valid pulse on any channel before signal counts as lost.

child-binding:
  description: RC channel to input-event-code binding
  properties:
    pwms:
      type: phandle-array
      required: true
      description: PWM capture channel wired to this receiver output.

    type:
      type: int
      required: true
      enum:
        - 3
        - 4
      description: Input event type, INPUT_EV_ABS (3) or INPUT_EV_MSC (4).

    zephyr,code:
      type: int
      required: true
      description: Code to emit.
```

## apps/firmware/dts/bindings/joystick.yaml
```yaml
# SPDX-License-Identifier: Apache-2.0

description: |
  USB HID joystick fed by two axes of an input device.

  Button 0, the commanding button, is on while the stick has been off center within
  center-timeout-ms and the input device sends sync events. A stick at center counts as no
  command, since some receivers hold their outputs at center after losing the transmitter.

compatible: "joystick"

include: base.yaml

properties:
  input:
    type: phandle
    required: true
    description: Input device to read the axes from.

  hid-device:
    type: phandle
    required: true
    description: zephyr,hid-device node the joystick reports through.

  led-strip:
    type: phandle
    description: LED showing the stick on an HSV color wheel while the commanding button is on.

  signal-timeout-ms:
    type: int
    default: 100
    description: Time without a sync event before signal counts as lost and the commanding button turns off.

  center-deadzone:
    type: int
    default: 1638
    description: Stick deflection, out of 32767, at or below which the stick counts as at center.

  center-timeout-ms:
    type: int
    default: 1000
    description: Time the stick may stay at center before the commanding button turns off.

  button-codes:
    type: array
    description: Input event codes read as buttons 1 onwards, in order.

  button-pressed-above:
    type: int
    default: 1500
    description: Input value above which a button counts as pressed.

  differential-drive:
    type: boolean
    description: The axes are the right and left wheel speeds of a differential drive, in that order.

child-binding:
  description: Joystick axis.
  properties:
    zephyr,code:
      type: int
      required: true
      description: Input event code carrying this axis.

    in-min:
      type: int
      required: true
      description: Input value at one end of the axis.

    in-max:
      type: int
      required: true
      description: Input value at the other end of the axis.

    invert-input:
      type: boolean
      description: Invert the input before scaling.
```
