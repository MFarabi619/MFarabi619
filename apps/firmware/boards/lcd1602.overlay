#include <zephyr/dt-bindings/gpio/gpio.h>

 /* QC1602A (HD44780) 16x2 -- 4-bit parallel, write-only            */
 /* LCD pin          ESP32-S3 devkitc                               */
 /*  1 VSS    -->  GND                                              */
 /*  2 VDD    -->  5V                                               */
 /*  3 V0     -->  1k -> GND        (fixed contrast, no pot)        */
 /*  4 RS     -->  GPIO4                                            */
 /*  5 RW     -->  GND              (write-only)                    */
 /*  6 E      -->  GPIO5                                            */
 /*  7-10 D0-D3 -> NC               (4-bit mode)                    */
 /* 11 D4     -->  GPIO6                                            */
 /* 12 D5     -->  GPIO7                                            */
 /* 13 D6     -->  GPIO15                                           */
 /* 14 D7     -->  GPIO16                                           */
 /* 15 A      -->  220R -> 5V                                       */
 /* 16 K      -->  NPN collector    (base <- GPIO17 via 1k)         */

/ {
	auxdisplay_0: auxdisplay {
		compatible = "hit,hd44780";
		mode = <4>;
		columns = <16>;
		rows = <2>;
		register-select-gpios = <&gpio0 4 GPIO_ACTIVE_HIGH>;
		enable-gpios = <&gpio0 5 GPIO_ACTIVE_HIGH>;
		data-bus-gpios = <0>, <0>, <0>, <0>,
				 <&gpio0 6 GPIO_ACTIVE_HIGH>,
				 <&gpio0 7 GPIO_ACTIVE_HIGH>,
				 <&gpio0 15 GPIO_ACTIVE_HIGH>,
				 <&gpio0 16 GPIO_ACTIVE_HIGH>;
		backlight-gpios = <&gpio0 17 GPIO_ACTIVE_HIGH>;
	};
};
