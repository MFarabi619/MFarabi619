## apps/embedded/Kconfig
```kconfig
rsource "../../libs/firmware/Kconfig"

config CELLULAR_ATTACH_TIMEOUT_MS
	int "Cellular attach timeout (milliseconds)"
	default 180000

source "Kconfig.zephyr"
```

## apps/embedded/boards/qemu_riscv32.conf
```kconfig
CONFIG_FLASH=y
CONFIG_FLASH_MAP=y
CONFIG_FLASH_SIMULATOR=y
CONFIG_FLASH_PAGE_LAYOUT=y

CONFIG_TEST_RANDOM_GENERATOR=y

CONFIG_DISK_ACCESS=y
CONFIG_DISK_DRIVERS=y
CONFIG_FILE_SYSTEM_EXT2=y
CONFIG_EXT2_FSTAB_AUTOMOUNT=y
CONFIG_FILE_SYSTEM_LITTLEFS=y

CONFIG_POSIX_API=y
CONFIG_POSIX_FSYNC=y
CONFIG_POSIX_FD_MGMT=y
CONFIG_POSIX_ENV_SHELL=y
CONFIG_POSIX_UNAME_SHELL=y
CONFIG_POSIX_FILE_SYSTEM=y
CONFIG_POSIX_FILE_SYSTEM_R=y
CONFIG_POSIX_C_LANG_SUPPORT_R=y

CONFIG_DYNAMIC_THREAD=y
CONFIG_DYNAMIC_THREAD_POOL_SIZE=2

CONFIG_SHELL_STACK_SIZE=16384
CONFIG_COMMON_LIBC_MALLOC_ARENA_SIZE=4096
```

## apps/embedded/boards/walter_procpu.conf
```kconfig
CONFIG_NET_HOSTNAME="walter"

CONFIG_ESPTOOLPY_FLASH_MODE_AUTO_DETECT=n
CONFIG_ESPTOOLPY_FLASHSIZE_16MB=y

CONFIG_ESP32_WIFI_TX_BA_WIN=32
CONFIG_ESP32_WIFI_RX_BA_WIN=32
CONFIG_ESP32_WIFI_AMSDU_TX_ENABLED=y
CONFIG_ESP32_WIFI_STATIC_RX_BUFFER_NUM=16
CONFIG_ESP32_WIFI_DYNAMIC_RX_BUFFER_NUM=64
CONFIG_ESP32_WIFI_DYNAMIC_TX_BUFFER_NUM=64

CONFIG_POWEROFF=y
CONFIG_PM_DEVICE=y
CONFIG_REGULATOR=y

CONFIG_LOG_BUFFER_SIZE=4096
```

## apps/embedded/boards/xiao_esp32s3_procpu.conf
```kconfig
CONFIG_NET_HOSTNAME="xiao"

CONFIG_ESPTOOLPY_OCT_FLASH=n
CONFIG_ESPTOOLPY_FLASH_MODE_AUTO_DETECT=n
CONFIG_MAIN_STACK_SIZE=8192
```

## apps/embedded/boards/xiao_esp32s3_procpu_sense.conf
```kconfig
CONFIG_NET_HOSTNAME="xiao-sense"
CONFIG_WIFI_USAGE_MODE_STA_AP=y

CONFIG_SPIRAM_MODE_OCT=y
CONFIG_ESPTOOLPY_OCT_FLASH=n
CONFIG_ESPTOOLPY_FLASHSIZE_8MB=y
CONFIG_ESPTOOLPY_FLASHFREQ_40M=y
CONFIG_ESPTOOLPY_FLASHMODE_QIO=y
CONFIG_ESP_SPIRAM_HEAP_SIZE=6291456

CONFIG_SDMMC_STACK=y
CONFIG_FS_FATFS_EXFAT=y
```

## apps/embedded/src/networking/wireguard/Kconfig
```kconfig
if WIREGUARD

config WIREGUARD_LOCAL_PRIVATE_KEY
	string "Local node private key (base64)"
	default ""

config WIREGUARD_LOCAL_TUNNEL_CIDR
	string "Local tunnel address with prefix"
	default "10.10.10.2/24"

config WIREGUARD_PEER_PUBLIC_KEY
	string "Peer public key (base64)"
	default "bBk3IoOmGxRJwPLCYl0QyoM/J74D+Pt72Q5mLxIiDmQ="

config WIREGUARD_PEER_ALLOWED_CIDR
	string "Peer allowed-IPs CIDR"
	default "10.10.10.0/24"

config WIREGUARD_PEER_ENDPOINT
	string "Peer endpoint host:port"
	default "10.0.0.162:51820"

config WIREGUARD_PEER_TUNNEL_ADDR
	string "Peer tunnel address used to kick off the first handshake"
	default "10.10.10.1"

endif # WIREGUARD
```

## apps/firmware/boards/esp32s3_8048S043/Kconfig
```kconfig
config HEAP_MEM_POOL_ADD_SIZE_BOARD
	int
	default 4096 if BOARD_ESP32S3_8048S043_ESP32S3_PROCPU
```

## apps/firmware/boards/esp32s3_8048S043/Kconfig.esp32s3_8048S043
```kconfig
config BOARD_ESP32S3_8048S043
	select SOC_ESP32S3_WROOM_N16R8
	select SOC_ESP32S3_PROCPU if BOARD_ESP32S3_8048S043_ESP32S3_PROCPU
```

## apps/firmware/boards/esp32s3_8048S043/Kconfig.sysbuild
```kconfig
choice BOOTLOADER
	default BOOTLOADER_MCUBOOT
endchoice

choice BOOT_SIGNATURE_TYPE
	default BOOT_SIGNATURE_TYPE_NONE
endchoice
```

## apps/firmware/boards/esp32s3_8048S043/board.yml
```yaml
board:
  name: esp32s3_8048S043
  full_name: Sunton ESP32-S3 4.3" 800x480
  vendor: espressif
  socs:
  - name: esp32s3
```

## apps/firmware/boards/esp32s3_8048S043_procpu.conf
```kconfig
CONFIG_NET_HOSTNAME="sunton-s043"

CONFIG_ESPTOOLPY_OCT_FLASH=n
CONFIG_ESPTOOLPY_FLASHSIZE_16MB=y
CONFIG_ESPTOOLPY_FLASHFREQ_40M=y
CONFIG_SPIRAM_MODE_OCT=y

CONFIG_WIFI_USAGE_MODE_STA_AP=y

CONFIG_SDMMC_STACK=y
CONFIG_FS_FATFS_EXFAT=y
```

## apps/firmware/boards/esp32s3_devkitc_procpu.conf
```kconfig
CONFIG_NET_HOSTNAME="esp32s3"

CONFIG_ESPTOOLPY_OCT_FLASH=n

CONFIG_LED_STRIP=y
CONFIG_LED_STRIP_SHELL=y
```

## apps/firmware/boards/nucleo_h723zg.conf
```kconfig
CONFIG_SYMTAB=y
CONFIG_INIT_STACKS=y
CONFIG_THREAD_NAME=y
CONFIG_THREAD_MONITOR=y
CONFIG_THREAD_ANALYZER=y
CONFIG_THREAD_STACK_INFO=y
CONFIG_THREAD_RUNTIME_STATS=y

CONFIG_LOG_BACKEND_SWO=y
CONFIG_MAIN_STACK_SIZE=4096
CONFIG_SHELL_STACK_SIZE=4096
CONFIG_HEAP_MEM_POOL_SIZE=4096
CONFIG_SYS_HEAP_RUNTIME_STATS=y
CONFIG_SYSTEM_WORKQUEUE_STACK_SIZE=2048

# CONFIG_ASSERT=y
CONFIG_STACK_SENTINEL=y
CONFIG_MPU_STACK_GUARD=y
CONFIG_DEBUG_THREAD_INFO=y
CONFIG_DEBUG_OPTIMIZATIONS=y
CONFIG_EXTRA_EXCEPTION_INFO=y

CONFIG_LED=y
CONFIG_LED_SHELL=y

CONFIG_I2C=y
CONFIG_I2C_SHELL=y
CONFIG_GPIO_SHELL=y

CONFIG_PWM=y
CONFIG_PWM_SHELL=y

CONFIG_INPUT=y
CONFIG_INPUT_SHELL=y

CONFIG_SENSOR=y
CONFIG_SENSOR_SHELL=y

CONFIG_NETWORKING=y
CONFIG_NET_IPV4=y
CONFIG_NET_TCP=y
CONFIG_NET_UDP=y
CONFIG_NET_SOCKETS=y

CONFIG_NET_DHCPV4=y
CONFIG_NET_CONFIG_SETTINGS=y
CONFIG_NET_CONFIG_NEED_IPV4=y
CONFIG_NET_CONFIG_AUTO_INIT=y

CONFIG_NET_MGMT=y
CONFIG_NET_MGMT_EVENT=y
CONFIG_NET_MGMT_EVENT_INFO=y
CONFIG_NET_SHELL=y

CONFIG_ENTROPY_GENERATOR=y

CONFIG_NET_PKT_RX_COUNT=16
CONFIG_NET_PKT_TX_COUNT=16
CONFIG_NET_BUF_RX_COUNT=32
CONFIG_NET_BUF_TX_COUNT=32
```

## apps/firmware/boards/qemu_riscv32.conf
```kconfig
CONFIG_FLASH=y
CONFIG_FLASH_MAP=y
CONFIG_FLASH_SIMULATOR=y
CONFIG_FLASH_PAGE_LAYOUT=y

CONFIG_TEST_RANDOM_GENERATOR=y

CONFIG_FILE_SYSTEM_LITTLEFS=y

# CONFIG_SQLITE=y  # re-enable once Rust SQLite backend is extended to non-xtensa bare-metal
CONFIG_COMMON_LIBC_MALLOC_ARENA_SIZE=262144

CONFIG_POSIX_API=y
CONFIG_POSIX_FSYNC=y
CONFIG_POSIX_FD_MGMT=y
CONFIG_POSIX_ENV_SHELL=y
CONFIG_POSIX_UNAME_SHELL=y
CONFIG_POSIX_FILE_SYSTEM=y
CONFIG_POSIX_FILE_SYSTEM_R=y
CONFIG_POSIX_C_LANG_SUPPORT_R=y

CONFIG_DYNAMIC_THREAD=y
CONFIG_DYNAMIC_THREAD_POOL_SIZE=2

CONFIG_MAIN_STACK_SIZE=8192
CONFIG_SHELL_STACK_SIZE=16384
```

## apps/firmware/boards/stm32f3_disco.conf
```kconfig
CONFIG_SYMTAB=y
CONFIG_INIT_STACKS=y
CONFIG_THREAD_NAME=y
CONFIG_THREAD_MONITOR=y
CONFIG_THREAD_ANALYZER=y
CONFIG_THREAD_STACK_INFO=y
CONFIG_THREAD_ANALYZER_AUTO=y
CONFIG_THREAD_RUNTIME_STATS=y

CONFIG_LOG_BACKEND_SWO=y
CONFIG_MAIN_STACK_SIZE=4096
CONFIG_SHELL_STACK_SIZE=4096
CONFIG_HEAP_MEM_POOL_SIZE=4096
CONFIG_SYS_HEAP_RUNTIME_STATS=y
CONFIG_SYSTEM_WORKQUEUE_STACK_SIZE=2048

# CONFIG_ASSERT=y
CONFIG_STACK_SENTINEL=y
CONFIG_DEBUG_THREAD_INFO=y
CONFIG_DEBUG_OPTIMIZATIONS=y
CONFIG_EXTRA_EXCEPTION_INFO=y

CONFIG_GPIO_SHELL=y
CONFIG_I2C_SHELL=y
CONFIG_INPUT=y
CONFIG_INPUT_SHELL=y
CONFIG_LED=y
CONFIG_LED_SHELL=y
CONFIG_SENSOR=y
CONFIG_SENSOR_SHELL=y
```

## apps/firmware/boards/walter_esp32s3_procpu.conf
```kconfig
CONFIG_NET_HOSTNAME="walter"

CONFIG_ESPTOOLPY_FLASHSIZE_16MB=y

CONFIG_ESP32_WIFI_TX_BA_WIN=32
CONFIG_ESP32_WIFI_RX_BA_WIN=32
CONFIG_ESP32_WIFI_AMSDU_TX_ENABLED=y
CONFIG_ESP32_WIFI_STATIC_RX_BUFFER_NUM=16
CONFIG_ESP32_WIFI_DYNAMIC_RX_BUFFER_NUM=64
CONFIG_ESP32_WIFI_DYNAMIC_TX_BUFFER_NUM=64

CONFIG_POWEROFF=y
CONFIG_PM_DEVICE=y
CONFIG_REGULATOR=y

CONFIG_LOG_BUFFER_SIZE=4096

CONFIG_NET_PKT_FILTER=y
CONFIG_NET_PKT_RX_COUNT=256
CONFIG_NET_PKT_TX_COUNT=256
CONFIG_NET_PKT_FILTER_IPV4_HOOK=y

CONFIG_NET_IPV4_NAT=y
CONFIG_NET_IPV4_FORWARDING=y
CONFIG_NET_IPV4_CONN_TRACK_MAX_NUM=256
CONFIG_NET_IPV4_IPTABLE_RULE_MAX_NUM=16

CONFIG_NET_L2_PPP=y
CONFIG_NET_L2_PPP_MGMT=y
CONFIG_NET_L2_PPP_OPTION_MRU=y
CONFIG_NET_L2_PPP_OPTION_DNS_USE=y
CONFIG_NET_L2_PPP_MAX_CONFIGURE_REQ_RETRANSMITS=4

CONFIG_MODEM=y
CONFIG_MODEM_STATS=y
CONFIG_MODEM_AT_SHELL=y
CONFIG_MODEM_CMUX_MTU=1500
CONFIG_MODEM_CELLULAR=y
CONFIG_MODEM_CELL_INFO=y
CONFIG_MODEM_CELLULAR_APN="m2minternet.apn" # or "rogersdefault.apn"
CONFIG_MODEM_CELLULAR_CHAT_BUFFER_SIZE=4096
CONFIG_MODEM_CELLULAR_UART_BUFFER_SIZES=2048

CONFIG_TASK_WDT=y
CONFIG_TASK_WDT_CHANNELS=4
CONFIG_TASK_WDT_MIN_TIMEOUT=1000
```

## apps/firmware/boards/walter_procpu.conf
```kconfig
CONFIG_POWEROFF=y
CONFIG_PM_DEVICE=y
CONFIG_REGULATOR=y

CONFIG_LOG_MODE_DEFERRED=y
CONFIG_LOG_BUFFER_SIZE=4096
CONFIG_LOG_MODE_IMMEDIATE=n

CONFIG_NET_HOSTNAME="walter"

CONFIG_ESPTOOLPY_FLASHSIZE_16MB=y
CONFIG_ESP_SPIRAM_HEAP_SIZE=262144
```

## apps/firmware/boards/xiao_esp32s3_procpu_sense.conf
```kconfig
CONFIG_NET_HOSTNAME="xiao-sense"

CONFIG_ESPTOOLPY_OCT_FLASH=n

# CONFIG_SQLITE=y

CONFIG_SDMMC_STACK=y
CONFIG_FS_FATFS_EXFAT=y

CONFIG_MCUMGR_GRP_FS=y
CONFIG_MCUMGR_GRP_FS_FILE_STATUS=y
CONFIG_MCUMGR_GRP_FS_HASH_SHA256=y
CONFIG_MCUMGR_GRP_FS_CHECKSUM_HASH=y
CONFIG_MCUMGR_GRP_FS_MAX_FILE_SIZE_4GB=y
CONFIG_MCUMGR_GRP_FS_CHECKSUM_IEEE_CRC32=y
```

## apps/firmware/zephyr/Kconfig
```kconfig
rsource "../networking/wireguard/Kconfig"

configdefault HAS_SEGGER_RTT
	default y

config FORCE_RUST_SUPPORTED
	bool
	default y
	select RUST_SUPPORTED

configdefault FILE_SYSTEM_SHELL
	default y if SHELL && FILE_SYSTEM

config PROMPT_TZ_OFFSET_MINUTES
	int "Prompt clock timezone offset (minutes from UTC)"
	default -240

if ESP_SPIRAM
configdefault ESP_SPIRAM_MEMTEST
	default y
endif

if SOC_SERIES_ESP32S3 && WIFI_ESP32
configdefault ESP32_WIFI_IRAM_OPT
	default y
configdefault ESP32_WIFI_RX_IRAM_OPT
	default y
configdefault ESP32_WIFI_STA_RECONNECT
	default y
endif

if BOARD_XIAO_ESP32S3 || BOARD_ESP32S3_DEVKITC
configdefault ESP_SPIRAM_HEAP_SIZE
	default 6291456

choice SPIRAM_MODE
	default SPIRAM_MODE_OCT
endchoice

choice ESPTOOLPY_FLASHMODE
	default ESPTOOLPY_FLASHMODE_QIO
endchoice

choice ESPTOOLPY_FLASHFREQ
	default ESPTOOLPY_FLASHFREQ_40M
endchoice

choice ESPTOOLPY_FLASHSIZE
	default ESPTOOLPY_FLASHSIZE_8MB
endchoice

choice WIFI_USAGE_MODE
	default WIFI_USAGE_MODE_STA_AP
endchoice
endif

if !BOARD_WALTER
configdefault MCUMGR_GRP_SHELL
	default y if MCUMGR && SHELL
configdefault SHELL_BACKEND_DUMMY
	default y if MCUMGR && SHELL
configdefault FLASH_SHELL
	default y if FLASH && SHELL && FLASH_PAGE_LAYOUT
configdefault FLASH_MAP_SHELL
	default y if FLASH_MAP && SHELL
endif

configdefault HEAP_MEM_POOL_SIZE
	default 65536

configdefault SHELL_STACK_SIZE
	default 8192 if SQLITE
	default 5200

configdefault SYSTEM_WORKQUEUE_STACK_SIZE
	default 4096
```

## apps/nuttx-zig/Kconfig
```kconfig
config APPS_NUTTX_ZIG
	tristate "Hello-Zig demo app"
	default n
	---help---
		Minimal Zig demo for NuttX. Prints a greeting then exits.

if APPS_NUTTX_ZIG

config APPS_NUTTX_ZIG_PROGNAME
	string "Program name"
	default "nuttx_zig"

config APPS_NUTTX_ZIG_PRIORITY
	int "Task priority"
	default 100

config APPS_NUTTX_ZIG_STACKSIZE
	int "Stack size"
	default DEFAULT_TASK_STACKSIZE

endif
```

## apps/nuttx-zig/west.yml
```yaml
manifest:
    projects:
        - name: nuttx
          revision: nuttx-12.13.0
          path: nuttxspace/nuttx
          url: https://github.com/apache/nuttx

        - name: nuttx-apps
          revision: nuttx-12.13.0
          path: nuttxspace/apps
          url: https://github.com/apache/nuttx-apps
```

## apps/walter-router/Kconfig
```kconfig
config WIFI_CREDENTIALS_AP_SSID
	string "Soft AP SSID"
	default "walter"

config WIFI_CREDENTIALS_AP_PASSWORD
	string "Soft AP WPA2 pre-shared key (empty = open AP)"
	default ""

config CELLULAR_ATTACH_TIMEOUT_MS
	int "Cellular attach timeout (milliseconds)"
	default 180000

source "Kconfig.zephyr"
```

## apps/xiao/Kconfig
```kconfig
rsource "../../libs/firmware/networking/wireguard/Kconfig"

source "Kconfig.zephyr"
```

## firmware/src/Kconfig
```kconfig
menu "Microvisor Test Suites"
	depends on ZTEST

config TEST_LED
	bool "LED strip tests"
	default y

endmenu
```
